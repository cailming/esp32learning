## s3cam/mic_wake_command_test/main/Kconfig.projbuild
```kconfig
menu "Voice services / uplink network"

config TTS_SERVER_URL
    string "ChatTTS streaming URL"
    default "http://192.168.1.92:8000/tts/stream"
    help
        ChatTTS streaming endpoint used by startup prompts, status queries,
        and local voice feedback.

config ASR_SERVER_URL
    string "FunASR recognition URL"
    default "http://192.168.1.92:8001/asr"
    help
        Base FunASR endpoint for dialog mode. Keep this value ending in /asr.
        The ESP32 dialog client automatically replaces the trailing /asr with
        /dialog when running the speech-to-speech path:

            ESP32 PCM -> /dialog -> FunASR -> ChatTTS -> PCM -> ESP32 Speaker

        The original /asr endpoint remains available for standalone ASR tests.

config ASR_VAD_PEAK_THRESHOLD
    int "Dialog VAD peak threshold"
    range 100 10000
    default 900
    help
        Peak amplitude threshold used on ESP32 to decide whether a PCM frame
        contains speech. Raise it in noisy rooms; lower it if quiet speech is
        not captured.

config ASR_VAD_SILENCE_MS
    int "Silence duration that ends one utterance (ms)"
    range 300 3000
    default 800

config ASR_MAX_UTTERANCE_MS
    int "Maximum length of one ASR utterance (ms)"
    range 2000 15000
    default 8000

config TTS_WIFI_STA_ENABLE
    bool "Enable Wi-Fi STA uplink for TTS / ASR"
    default n
    help
        Keep the existing S3CAM-Photo SoftAP/web page and additionally connect
        the ESP32 to your LAN so it can reach both ChatTTS and FunASR servers.
        The SoftAP remains available at http://192.168.4.1/.

if TTS_WIFI_STA_ENABLE

config TTS_WIFI_STA_SSID
    string "Uplink Wi-Fi SSID"
    default ""

config TTS_WIFI_STA_PASSWORD
    string "Uplink Wi-Fi password"
    default ""

endif

endmenu
```
